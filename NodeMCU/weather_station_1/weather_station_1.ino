//Weather Station 1

#include <ESP8266WiFi.h>
#include <Firebase_ESP_Client.h>
#include <DHTesp.h>
#include <ESP8266Ping.h>
#include <Wire.h>
#include <Adafruit_GFX.h>
#include <Adafruit_SSD1306.h>

#define SCREEN_WIDTH 128 // OLED display width,  in pixels
#define SCREEN_HEIGHT 64 // OLED display height, in pixels
Adafruit_SSD1306 oled(SCREEN_WIDTH, SCREEN_HEIGHT, &Wire, -1);

// 'VIT_oled', 128x29px
const unsigned char epd_bitmap_VIT_oled [] PROGMEM = {
  0xff, 0xff, 0xff, 0xff, 0xff, 0xff, 0xff, 0xff, 0xff, 0xff, 0xff, 0xff, 0xff, 0xff, 0xff, 0xff,
  0xff, 0xff, 0xff, 0xff, 0xff, 0xff, 0xff, 0xff, 0xff, 0xff, 0xff, 0xff, 0xff, 0xff, 0xff, 0xff,
  0xff, 0xff, 0xff, 0xff, 0xff, 0xff, 0xff, 0xff, 0xff, 0xff, 0xff, 0xff, 0xff, 0xff, 0xff, 0xff,
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  0xff, 0xff, 0xff, 0xff, 0xff, 0xff, 0xff, 0xff, 0xff, 0xff, 0xff, 0xff, 0xff, 0xff, 0xff, 0xff
};
// Array of all bitmaps for convenience. (Total bytes used to store images in PROGMEM = 480)
const int epd_bitmap_allArray_LEN = 1;
const unsigned char* epd_bitmap_allArray[1] = {
  epd_bitmap_VIT_oled
};

//Provide the token generation process info.
#include "addons/TokenHelper.h"
//Provide the RTDB payload printing info and other helper functions.
#include "addons/RTDBHelper.h"

// Insert your network credentials

const char *ssid1 = "SSID1";
const char *password1 = "Password1";
const char *ssid2 = "SSID2";
const char *password2 = "Password2";
int flag = 1;
const IPAddress remote_ip(208, 80, 153, 224);


#define DHTTYPE DHT22
DHTesp dht;
int mq135 = A0;
int aqi = 0;
float humidity = 0.0;
float temperature = 0.0;

// Insert Firebase project API Key
#define API_KEY "API KEY"

// Insert RTDB URLefine the RTDB URL */
#define DATABASE_URL "RTDB_URL"

//Define Firebase Data object
FirebaseData fbdo;

FirebaseAuth auth;
FirebaseConfig config;

unsigned long sendDataPrevMillis = 0;
int count = 0;
bool signupOK = false;

void setup() {
  Serial.begin(115200);
  if (!oled.begin(SSD1306_SWITCHCAPVCC, 0x3C)) {
    Serial.println(F("SSD1306 allocation failed"));
    while (true);
  }
  while (WiFi.status() == WL_DISCONNECTED) {
    myNetwork();
  }
  Serial.println("Successfully Connected ");
  dht.setup(D5, DHTesp::DHT22);

  /* Assign the api key (required) */
  config.api_key = API_KEY;

  /* Assign the RTDB URL (required) */
  config.database_url = DATABASE_URL;

  /* Sign up */
  if (Firebase.signUp(&config, &auth, "", "")) {
    Serial.println("ok");
    signupOK = true;
  }
  else {
    Serial.printf("%s\n", config.signer.signupError.message.c_str());
  }

  /* Assign the callback function for the long running token generation task */
  config.token_status_callback = tokenStatusCallback; //see addons/TokenHelper.h

  Firebase.begin(&config, &auth);
  Firebase.reconnectWiFi(true);
  oled.clearDisplay(); // clear display
  oled.setTextSize(1);          // text size
  oled.setTextColor(WHITE);     // text color
}

void myNetwork() {

  Serial.println("Searching Wifi......");
  int network = WiFi.scanNetworks();          //5
  for (int i = 0 ; i < network; i++) {
    switch (flag) {
      case 1:
        flag = 2;
        if (WiFi.SSID(i) == ssid1) {
          WiFi.begin(ssid1, password1);
          Serial.println("Wifi Found");
          Serial.println("Connecting with Jio Please Wait ");
          while (WiFi.status() != WL_CONNECTED) {
            Serial.print(".");
            delay(300);
          }
          Serial.println();
          Serial.print("Connected with IP: ");
          Serial.println(WiFi.localIP());
          Serial.println();

          break;
        }
      case 2:
        flag = 1;
        if (WiFi.SSID(i) == ssid2) {
          WiFi.begin(ssid2, password2);
          Serial.println("Wifi Found");
          Serial.println("Connecting with Airport Please Wait ");
          while (WiFi.status() != WL_CONNECTED) {
            Serial.print(".");
            delay(300);
          }
          Serial.println();
          Serial.print("Connected with IP: ");
          Serial.println(WiFi.localIP());
          Serial.println();

          break;
        }
    }
  }
}

void loop() {
  if (!Ping.ping(remote_ip)) {
    Serial.println("No Internet");
    myNetwork();
  } else {
    oled.clearDisplay();
    if (Firebase.ready() && signupOK && (millis() - sendDataPrevMillis > 1500 || sendDataPrevMillis == 0)) {
      sendDataPrevMillis = millis();
      humidity = dht.getHumidity();
      temperature = dht.getTemperature(); // dht.readTemperature(true) for Fahrenheit
      aqi = analogRead(mq135);
      Serial.print(dht.getStatusString());

      // display logo
      oled.setCursor(0, 0);
      oled.drawBitmap(0, 0, epd_bitmap_VIT_oled, 128, 29, WHITE);
      oled.display();

      // display temperature
      String text = "Temperature: " + String(temperature);
      oled.setCursor(0, 34);        // position to display
      oled.print(text);
      oled.print((char)247);
      oled.println(" C");
      oled.display();


      // display humidity
      String text1 = "Humidity: " + String(humidity) + " %";
      oled.setCursor(0, 44);        // position to display
      oled.println(text1);
      oled.display();


      String text2 = "AQI: " + String(aqi);
      oled.setCursor(0, 54);        // position to display
      oled.println(text2);
      oled.display();

      //aqi
      if (Firebase.RTDB.setInt(&fbdo, "station1/aqi1", aqi)) {
        Serial.println("PASSED");
        Serial.println("PATH: " + fbdo.dataPath());
        Serial.println("TYPE: " + fbdo.dataType());
      }
      else {
        Serial.println("FAILED");
        Serial.println("REASON: " + fbdo.errorReason());
      }

      //temperature
      if (Firebase.RTDB.setFloat(&fbdo, "station1/temp1", temperature)) {
        Serial.println("PASSED");
        Serial.println("PATH: " + fbdo.dataPath());
        Serial.println("TYPE: " + fbdo.dataType());
      }
      else {
        Serial.println("FAILED");
        Serial.println("REASON: " + fbdo.errorReason());
      }

      //humidity
      if (Firebase.RTDB.setFloat(&fbdo, "station1/humidity1", humidity)) {
        Serial.println("PASSED");
        Serial.println("PATH: " + fbdo.dataPath());
        Serial.println("TYPE: " + fbdo.dataType());
      }
      else {
        Serial.println("FAILED");
        Serial.println("REASON: " + fbdo.errorReason());
      }
    }
  }
}
